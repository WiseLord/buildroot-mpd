/dts-v1/;
/plugin/;

/ {
	compatible = "allwinner,sun8i-h3";

	fragment@0 {
		target = <&uart2>;
		__overlay__ {
			pinctrl-names = "default";
			pinctrl-0 = <&uart2_pins>;
			status = "okay";
		};
	};
};
